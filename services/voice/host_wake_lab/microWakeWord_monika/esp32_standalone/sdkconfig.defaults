## services/voice/host_wake_lab/wakenet10_poc/sdkconfig.defaults
```kconfig
# Isolated, NEVER flash on the installed Spotpear.
# Pinned builder: espressif/idf v6.0.1 ESP32-S3.
CONFIG_IDF_TARGET="esp32s3"
CONFIG_ESPTOOLPY_FLASHSIZE_16MB=y
CONFIG_ESPTOOLPY_FLASHMODE_QIO=y
CONFIG_PARTITION_TABLE_CUSTOM=y
CONFIG_PARTITION_TABLE_CUSTOM_FILENAME="partitions_poc.csv"
CONFIG_SR_WN_WN10_RU_PRIVETESP=y
CONFIG_SPIRAM=y
CONFIG_SPIRAM_MODE_OCT=y
CONFIG_SPIRAM_SPEED_80M=y
CONFIG_ESP_DEFAULT_CPU_FREQ_MHZ_240=y
CONFIG_ESP_MAIN_TASK_STACK_SIZE=8192
```
